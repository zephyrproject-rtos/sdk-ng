## cmake/zephyr/Kconfig
```kconfig
# SPDX-License-Identifier: Apache-2.0

config TOOLCHAIN_ZEPHYR_0_18
	def_bool y

config TOOLCHAIN_ZEPHYR_SUPPORTS_THREAD_LOCAL_STORAGE
	def_bool y
	select TOOLCHAIN_SUPPORTS_THREAD_LOCAL_STORAGE

config TOOLCHAIN_ZEPHYR_SUPPORTS_GNU_EXTENSIONS
	def_bool y
	select TOOLCHAIN_SUPPORTS_GNU_EXTENSIONS

config PICOLIBC_SUPPORTED
	def_bool y
	depends on "$(ZEPHYR_TOOLCHAIN_VARIANT)" = "zephyr"
	help
	  Zephyr SDK >=0.16 always supports Picolibc for C and C++ development.

config PICOLIBC_DEFAULT
	def_bool y
	depends on "$(ZEPHYR_TOOLCHAIN_VARIANT)" = "zephyr"
	help
	  Zephyr SDK >=0.17.1 always uses Picolibc

# libstdc++ is built without exception support in -Os mode
# gcc 14.3 has bugs compiling with -Os on riscv
choice COMPILER_OPTIMIZATIONS
	default SPEED_OPTIMIZATIONS if ("$(TOOLCHAIN_VARIANT_COMPILER)" = "gnu") && CPP_EXCEPTIONS
	default SPEED_OPTIMIZATIONS if ("$(TOOLCHAIN_VARIANT_COMPILER)" = "gnu") && RISCV
endchoice
```

## meta-zephyr-sdk/conf/distro/include/zephyr-sdk.inc
```bitbake
SANITY_TESTED_DISTROS = " \
            Ubuntu-14.04 \n \
            Ubuntu-15.04 \n \
            Ubuntu-16.04 \n \
            Ubuntu-18.04 \n \
            Fedora-23 \n \
            "

DISTRO = "zephyr-sdk"
DISTRO_CODENAME = "zephyr-sdk"
DISTRO_NAME = "Zephyr Yocto Toolchain"
DISTRO_FEATURES = ""
DISTRO_FEATURES_NATIVE = ""
DISTRO_FEATURES_BACKFILL = ""
DISTRO_FEATURES_NATIVESDK = ""

MAINTAINER = "Zephyr developers / devops team"

SSTATE_DIR ?= "${TOPDIR}/../zephyr-cache/sstate-cache"
CACHE_forcevariable = "${TOPDIR}/../zephyr-cache/cache"
PERSISTENT_DIR = "${TOPDIR}/../zephyr-cache/persistent"
DL_DIR ?= "${TOPDIR}/../zephyr-downloads"

PREFERRED_VERSION_meson:forcevariable = "1.7.%"
PREFERRED_VERSION_nativesdk-meson:forcevariable = "1.7.%"
```

## meta-zephyr-sdk/conf/distro/zephyr-sdk.conf
```bitbake
require conf/distro/poky.conf
require include/zephyr-sdk.inc

DISTRO_VERSION = "0.10"
PACKAGE_CLASSES = "package_ipk"
TARGET_VENDOR = "-zephyr"
```

## meta-zephyr-sdk/conf/layer.conf
```bitbake
# We have a conf and classes directory, add to BBPATH
BBPATH := "${BBPATH}:${LAYERDIR}"

# We have a packages directory, add to BBFILES
BBFILES += "${LAYERDIR}/recipes*/*/*.bb ${LAYERDIR}/recipes*/*/*.bbappend"

LICENSE_PATH += "${LAYERDIR}/files/additional-licenses"

BBFILE_COLLECTIONS += "zephyr-sdk"
BBFILE_PATTERN_zephyr-sdk := "^${LAYERDIR}/"
BBFILE_PRIORITY_zephyr-sdk = "8"
```

## meta-zephyr-sdk/conf/machine/arc.conf
```bitbake
require conf/machine/arch-arc.inc

PREFERRED_VERSION_gcc-cross-${TARGET_ARCH} ?= "6.x.arc"
PREFERRED_VERSION_gcc-cross-canadian-${TRANSLATED_TARGET_ARCH} ?= "6.x.arc"
PREFERRED_VERSION_libgcc ?= "6.x.arc"

PREFERRED_VERSION_binutils-cross-${TARGET_ARCH} ?= "2.26+gitarc"
PREFERRED_VERSION_binutils-cross-canadian-${TRANSLATED_TARGET_ARCH} ?= "2.26+gitarc"

PREFERRED_VERSION_gdb-cross-canadian-${TRANSLATED_TARGET_ARCH} ?= "7.12+gitarc"

TARGET_LINK_HASH_STYLE = ""
```

## meta-zephyr-sdk/conf/machine/arch-arc.inc
```bitbake
DEFAULTTUNE ?= "arc"

TUNE_ARCH = "arc"
TUNE_PKGARCH = "arc"
TUNE_FEATURES_tune-arc = "littleendian"
TUNE_CCARGS = ""

TUNEVALID[littleendian] = "Little endian mode"

def arc_siteinfo_setfunc(archinfo, osinfo, targetinfo, d):
	archinfo['arc'] = "endian-little bit-32 "
	osinfo['linux'] = "common-linux common-glibc"
	targetinfo['arc-linux'] = "arc-linux"
	return archinfo, osinfo, targetinfo

SITEINFO_EXTRA_DATAFUNCS = "arc_siteinfo_setfunc"

def arc_machdata_setfunc(machdata, d):
    machdata["elf"] = { "arc" : (195,    0,    0,  True,  32), }
    return machdata

PACKAGEQA_EXTRA_MACHDEFFUNCS = "arc_machdata_setfunc"
```

## meta-zephyr-sdk/conf/machine/arch-iamcu.inc
```bitbake
DEFAULTTUNE ?= "iamcu"

TARGET_OS_iamcu = "elfiamcu"
TARGET_ARCH = "i586"

TUNE_PKGARCH = "iamcu"
TUNE_FEATURES_tune-iamcu = "iamcu"
TUNE_CCARGS = "-miamcu -m32"
TUNE_ARCH = "i586"
TUNEVALID[iamcu] = "Intel MCU"

def iamcu_siteinfo_setfunc(archinfo, osinfo, targetinfo, d):
	archinfo['iamcu'] = "endian-little bit-32 "
	osinfo['linux'] = "common-linux common-glibc"
	targetinfo['iamcu-linux'] = "iamcu-linux"
	return archinfo, osinfo, targetinfo

SITEINFO_EXTRA_DATAFUNCS = "iamcu_siteinfo_setfunc"
```

## meta-zephyr-sdk/conf/machine/arch-nios2.inc
```bitbake
# Nios2 Architecture Definition

DEFAULTTUNE ?= "nios2"

TUNE_ARCH = "nios2"
TUNE_PKGARCH = "nios2"
TUNE_FEATURES_tune-nios2 = "nios2"

TUNEVALID[bigendian] = "Enable big-endian mode"
TUNE_CCARGS .= "${@bb.utils.contains('TUNE_FEATURES', 'bigendian', ' -meb', '', d)}"

TUNEVALID[hw-mul] = "Enable Nios2 Hardware Multiply"
TUNE_CCARGS .= "${@bb.utils.contains('TUNE_FEATURES', 'hw-mul', ' -mhw-mul', '', d)}"

TUNEVALID[no-hw-mul] = "Disable Nios2 Hardware Multiply"
TUNE_CCARGS .= "${@bb.utils.contains('TUNE_FEATURES', 'no-hw-mul', ' -mno-hw-mul', '', d)}"

TUNEVALID[nios2] = "Altera Nios2"

def nios2_machdata_setfunc(machdata, d):
    machdata["elf"] = {"nios2":  (113, 0, 0, True, 32), }
    return machdata

PACKAGEQA_EXTRA_MACHDEFFUNCS = "nios2_machdata_setfunc"
```

## meta-zephyr-sdk/conf/machine/arch-riscv32.inc
```bitbake
DEFAULTTUNE ?= "riscv32"

TUNE_ARCH = "riscv32"
TUNE_PKGARCH = "riscv32"
TUNE_FEATURES_tune-riscv32 = "littleendian"
TUNE_CCARGS = " -nostdlib "

TUNEVALID[littleendian] = "Little endian mode"

def riscv32_siteinfo_setfunc(archinfo, osinfo, targetinfo, d):
	archinfo['riscv32'] = "endian-little bit-32 "
	osinfo['linux'] = "common-linux common-glibc"
	targetinfo['riscv32-linux'] = "riscv32-linux"
	return archinfo, osinfo, targetinfo

SITEINFO_EXTRA_DATAFUNCS = "riscv32_siteinfo_setfunc"

def riscv32_machdata_setfunc(machdata, d):
    machdata["elf"] = { "riscv32" : (243,    0,    0,  True,  32), }
    return machdata

PACKAGEQA_EXTRA_MACHDEFFUNCS = "riscv32_machdata_setfunc"
```

## meta-zephyr-sdk/conf/machine/arch-xtensa.inc
```bitbake
# Xtensa Architecture Definition

DEFAULTTUNE ?= "xtensa"

TUNEVALID[xtensa] = "Enable Xtensa"
AVAILTUNES += "xtensa"

TUNEVALID[longcalls] = "Enable long calls: emit 32-bit call sequences"
TUNE_CCARGS .= "${@bb.utils.contains('TUNE_FEATURES', 'longcalls', ' -mlongcalls', '', d)}"
AVAILTUNES += "longcalls"

TUNEVALID[target-align] = "Try to align branch targets"
TUNE_CCARGS .= "${@bb.utils.contains('TUNE_FEATURES', 'target-align', ' -mtarget-align', '', d)}"
AVAILTUNES += "target-align"

TUNE_ARCH = "xtensa"
TUNE_PKGARCH = "xtensa"

TUNE_FEATURES_tune-xtensa = "xtensa"

def xtensa_machdata_setfunc(machdata, d):
    machdata["elf"] = {"xtensa":  (94, 0, 0, True, 32), }
    return machdata

PACKAGEQA_EXTRA_MACHDEFFUNCS = "xtensa_machdata_setfunc"

def xtensa_siteinfo_setfunc(archinfo, osinfo, targetinfo, d):
    archinfo['xtensa'] = "endian-little bit-32 "
    osinfo['linux'] = "common-linux common-glibc"
    targetinfo['xtensa-linux'] = "xtensa-linux"
    return archinfo, osinfo, targetinfo

SITEINFO_EXTRA_DATAFUNCS = "xtensa_siteinfo_setfunc"
```

## meta-zephyr-sdk/conf/machine/riscv32.conf
```bitbake
require conf/machine/arch-riscv32.inc

PREFERRED_VERSION_gcc-cross-${TARGET_ARCH} ?= "6.x.riscv32"
PREFERRED_VERSION_gcc-cross-canadian-${TRANSLATED_TARGET_ARCH} ?= "6.x.riscv32"
PREFERRED_VERSION_libgcc ?= "6.x.riscv32"

PREFERRED_VERSION_binutils-cross-${TARGET_ARCH} ?= "2.27+gitriscv32"
PREFERRED_VERSION_binutils-cross-canadian-${TRANSLATED_TARGET_ARCH} ?= "2.27+gitriscv32"

PREFERRED_VERSION_gdb-cross-canadian-${TRANSLATED_TARGET_ARCH} ?= "7.x.riscv32"

TARGET_LINK_HASH_STYLE = ""
```
